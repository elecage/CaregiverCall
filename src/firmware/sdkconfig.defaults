## src/firmware/sdkconfig.defaults
```kconfig
CONFIG_IDF_TARGET="esp32c3"
CONFIG_ESPTOOLPY_FLASHSIZE_4MB=y
CONFIG_PARTITION_TABLE_CUSTOM=y
CONFIG_PARTITION_TABLE_CUSTOM_FILENAME="partitions.csv"
CONFIG_ENABLE_CHIP_SHELL=y
CONFIG_CHIP_DEVICE_PRODUCT_NAME="CaregiverCall"
CONFIG_CHIP_DEVICE_VENDOR_NAME="elecage"
CONFIG_ESP_PHY_MAX_WIFI_TX_POWER=10
CONFIG_BT_ENABLED=y
# CONFIG_BT_BLUEDROID_ENABLED is not set
CONFIG_BT_NIMBLE_ENABLED=y
CONFIG_BT_CONTROLLER_ENABLED=y
CONFIG_ENABLE_CHIPOBLE=y
CONFIG_USE_BLE_ONLY_FOR_COMMISSIONING=y
# CONFIG_EXAMPLE_COMMISSIONABLE_DATA_PROVIDER is not set
CONFIG_CUSTOM_COMMISSIONABLE_DATA_PROVIDER=y
# CONFIG_SUPPORT_CLOSURE_CONTROL_CLUSTER is not set
CONFIG_MBEDTLS_HKDF_C=y
```
